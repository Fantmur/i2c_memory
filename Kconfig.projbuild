## Kconfig.projbuild
```kconfig
menu "Example Configuration"
 
    config SDA_GPIO
        int "SDA GPIO number"
        range 0 48
        default 21
        help
            GPIO number SDA.
 
    config SCL_GPIO
        int "SCL GPIO number"
        range 0 48
        default 22
        help
            GPIO number SCL.
 
endmenu
```
